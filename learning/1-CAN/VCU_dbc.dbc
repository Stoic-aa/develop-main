VERSION ""

NS_ :

BS_:

BU_: BMS VCU1
VAL_TABLE_ VCU_BMSIsolationDetdReq 1 "Request" 0 "No_Request" ;
VAL_TABLE_ RollingCounter_VCU1 15 "Valid" 0 "Valid" ;

BO_ 207 VCU1: 8 VCU1
 SG_ VCU_BMSIsolationDetdReq : 6|1@1- (1,0) [0|1] ""  BMS
 SG_ RollingCounter_VCU1 : 0|4@1+ (1,0) [0|15] ""  BMS

BA_DEF_ BO_  "GenMsgSendType" ENUM  "test1","test2","test3","test4";
BA_DEF_ BO_  "GenMsgCycleTime" INT 0 65535;
BA_DEF_  "BusType" STRING ;
BA_DEF_DEF_  "GenMsgSendType" "test1";
BA_DEF_DEF_  "GenMsgCycleTime" 0;
BA_DEF_DEF_  "BusType" "CAN";
BA_ "GenMsgCycleTime" BO_ 207 10;
VAL_ 207 VCU_BMSIsolationDetdReq 1 "Request" 0 "No_Request" ;
VAL_ 207 RollingCounter_VCU1 15 "Valid" 0 "Valid" ;
